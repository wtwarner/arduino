f9dasm: M6800/1/2/3/8/9 / H6309 Binary/OS9/FLEX9 Disassembler V1.83
Loaded binary file /Users/wwarnerjr/Documents/Arduino/eprom-explorer-clock/exp-10.bin

;****************************************************
;* Used Labels                                      *
;****************************************************

M0000   EQU     $0000
M0001   EQU     $0001
M0002   EQU     $0002
M0004   EQU     $0004
M0005   EQU     $0005
M0008   EQU     $0008
M000B   EQU     $000B
M000D   EQU     $000D
M000F   EQU     $000F
M0010   EQU     $0010
M0012   EQU     $0012
M0056   EQU     $0056
M0064   EQU     $0064
M0080   EQU     $0080
M0081   EQU     $0081
M0082   EQU     $0082
M0083   EQU     $0083
M0084   EQU     $0084
M0085   EQU     $0085
M0087   EQU     $0087
M0089   EQU     $0089
M008A   EQU     $008A
M008B   EQU     $008B
M008C   EQU     $008C
M008D   EQU     $008D
M008F   EQU     $008F
M0090   EQU     $0090
M0092   EQU     $0092
M0093   EQU     $0093
M0095   EQU     $0095
M0096   EQU     $0096
M0098   EQU     $0098
M0099   EQU     $0099
M009B   EQU     $009B
M009C   EQU     $009C
M009E   EQU     $009E
M009F   EQU     $009F
M00A1   EQU     $00A1
M00A2   EQU     $00A2
M00A4   EQU     $00A4
M00A5   EQU     $00A5
M00A7   EQU     $00A7
M00A8   EQU     $00A8
M00AA   EQU     $00AA
M00AB   EQU     $00AB
M00AD   EQU     $00AD
M00AE   EQU     $00AE
M00B0   EQU     $00B0
M00C3   EQU     $00C3
M00C5   EQU     $00C5
M00C6   EQU     $00C6
M00C8   EQU     $00C8
M00C9   EQU     $00C9
M00CB   EQU     $00CB
M00CC   EQU     $00CC
M00CD   EQU     $00CD
M00CF   EQU     $00CF
M00D0   EQU     $00D0
M00D2   EQU     $00D2
M00D3   EQU     $00D3
M00D5   EQU     $00D5
M00D6   EQU     $00D6
M00D7   EQU     $00D7
M00D8   EQU     $00D8
M00D9   EQU     $00D9
M00DA   EQU     $00DA
M00DB   EQU     $00DB
M00DC   EQU     $00DC
M00DD   EQU     $00DD
M00DE   EQU     $00DE
M00DF   EQU     $00DF
M00E0   EQU     $00E0
M00E1   EQU     $00E1
M00E2   EQU     $00E2
M00EA   EQU     $00EA
M00FF   EQU     $00FF
M023B   EQU     $023B
M02DB   EQU     $02DB
M02EB   EQU     $02EB
M0328   EQU     $0328
M033B   EQU     $033B
M03CB   EQU     $03CB
M03E8   EQU     $03E8
M05C8   EQU     $05C8
M070B   EQU     $070B
M07C0   EQU     $07C0
M0986   EQU     $0986
M0A00   EQU     $0A00
M0ADA   EQU     $0ADA
M0C00   EQU     $0C00
M1000   EQU     $1000
M1100   EQU     $1100
M2008   EQU     $2008
M28E6   EQU     $28E6
M3FFF   EQU     $3FFF
M6000   EQU     $6000
M60F8   EQU     $60F8
M7000   EQU     $7000
M7AEA   EQU     $7AEA
M7EDA   EQU     $7EDA
MC000   EQU     $C000
MD456   EQU     $D456

;****************************************************
;* Program Code / Data Areas                        *
;****************************************************

        ORG     $F800

hdlr_IRQ_OCF LDAB    M0002                    ;F800: D6 02          '..'
        LDAA    M0081                    ;F802: 96 81          '..'
        ASLD                             ;F804: 05             '.'
        STAA    M0081                    ;F805: 97 81          '..'
        LDAA    M0008                    ;F807: 96 08          '..'
        LDD     M000B                    ;F809: DC 0B          '..'
        ADDD    #M0ADA                   ;F80B: C3 0A DA       '...'
        STD     M000B                    ;F80E: DD 0B          '..'
        CLR     M7000                    ;F810: 7F 70 00       '.p.'
        LDAA    M0084                    ;F813: 96 84          '..'
        TAB                              ;F815: 16             '.'
        ORAB    M00D8                    ;F816: DA D8          '..'
        STAB    M6000                    ;F818: F7 60 00       '.`.'
        LDX     #M0084                   ;F81B: CE 00 84       '...'
ZF81E   INX                              ;F81E: 08             '.'
        ASLA                             ;F81F: 48             'H'
        BNE     ZF81E                    ;F820: 26 FC          '&.'
        LDAA    ,X                       ;F822: A6 00          '..'
        STAA    M7000                    ;F824: B7 70 00       '.p.'
        ASL     >M0084                   ;F827: 78 00 84       'x..'
        BEQ     ZF831                    ;F82A: 27 05          ''.'
        LDAA    #$08                     ;F82C: 86 08          '..'
        STAA    M0008                    ;F82E: 97 08          '..'
        RTI                              ;F830: 3B             ';'
ZF831   LDAA    #$04                     ;F831: 86 04          '..'
        STAA    M0084                    ;F833: 97 84          '..'
        LDAA    M008B                    ;F835: 96 8B          '..'
        DECA                             ;F837: 4A             'J'
        STAA    M008B                    ;F838: 97 8B          '..'
        BEQ     ZF86D                    ;F83A: 27 31          ''1'
        DECA                             ;F83C: 4A             'J'
        BEQ     ZF846                    ;F83D: 27 07          ''.'
        DECA                             ;F83F: 4A             'J'
        BEQ     ZF875                    ;F840: 27 33          ''3'
        CLR     >M008B                   ;F842: 7F 00 8B       '...'
        RTI                              ;F845: 3B             ';'
ZF846   LDAB    M008C                    ;F846: D6 8C          '..'
        LDX     #M008A                   ;F848: CE 00 8A       '...'
        ABX                              ;F84B: 3A             ':'
        ASLB                             ;F84C: 58             'X'
        ABX                              ;F84D: 3A             ':'
        LDD     M000D                    ;F84E: DC 0D          '..'
        SUBD    M009C                    ;F850: 93 9C          '..'
        SUBD    ,X                       ;F852: A3 00          '..'
        ASRA                             ;F854: 47             'G'
        RORB                             ;F855: 56             'V'
        ASRA                             ;F856: 47             'G'
        RORB                             ;F857: 56             'V'
        ADDD    ,X                       ;F858: E3 00          '..'
        STD     ,X                       ;F85A: ED 00          '..'
        LDAA    M008C                    ;F85C: 96 8C          '..'
        DECA                             ;F85E: 4A             'J'
        BNE     ZF863                    ;F85F: 26 02          '&.'
        LDAA    #$05                     ;F861: 86 05          '..'
ZF863   STAA    M008C                    ;F863: 97 8C          '..'
ZF865   STAA    M1000                    ;F865: B7 10 00       '...'
        LDAA    #$09                     ;F868: 86 09          '..'
        STAA    M0008                    ;F86A: 97 08          '..'
        RTI                              ;F86C: 3B             ';'
ZF86D   LDD     M000B                    ;F86D: DC 0B          '..'
        STD     M009C                    ;F86F: DD 9C          '..'
        LDAA    #$0F                     ;F871: 86 0F          '..'
        BRA     ZF865                    ;F873: 20 F0          ' .'
ZF875   LDAA    M0083                    ;F875: 96 83          '..'
        ADDA    M008F                    ;F877: 9B 8F          '..'
        STAA    M008F                    ;F879: 97 8F          '..'
        LDD     M000B                    ;F87B: DC 0B          '..'
        ADCB    M0082                    ;F87D: D9 82          '..'
        ADCA    #$00                     ;F87F: 89 00          '..'
        TST     >M0082                   ;F881: 7D 00 82       '}..'
        BPL     ZF887                    ;F884: 2A 01          '*.'
        DECA                             ;F886: 4A             'J'
ZF887   STD     M000B                    ;F887: DD 0B          '..'
        LDX     M0082                    ;F889: DE 82          '..'
        LDAA    M0081                    ;F88B: 96 81          '..'
        CMPA    #$1C                     ;F88D: 81 1C          '..'
        BNE     ZF895                    ;F88F: 26 04          '&.'
        DEC     >M000B                   ;F891: 7A 00 0B       'z..'
        DEX                              ;F894: 09             '.'
ZF895   CMPA    #$E3                     ;F895: 81 E3          '..'
        BNE     ZF89D                    ;F897: 26 04          '&.'
        INC     >M000B                   ;F899: 7C 00 0B       '|..'
        INX                              ;F89C: 08             '.'
ZF89D   STX     M0082                    ;F89D: DF 82          '..'
        DEC     >M0092                   ;F89F: 7A 00 92       'z..'
        BNE     ZF8FD                    ;F8A2: 26 59          '&Y'
        LDAA    #$78                     ;F8A4: 86 78          '.x'
        STAA    M0092                    ;F8A6: 97 92          '..'
        LDAA    M0095                    ;F8A8: 96 95          '..'
        ADDA    #$01                     ;F8AA: 8B 01          '..'
        DAA                              ;F8AC: 19             '.'
        STAA    M0095                    ;F8AD: 97 95          '..'
        BEQ     ZF8FE                    ;F8AF: 27 4D          ''M'
        LDAA    M0098                    ;F8B1: 96 98          '..'
        LDX     M008D                    ;F8B3: DE 8D          '..'
        CPX     M00A8                    ;F8B5: 9C A8          '..'
        BCC     ZF8BD                    ;F8B7: 24 04          '$.'
        STX     M00A8                    ;F8B9: DF A8          '..'
        STAA    M00AA                    ;F8BB: 97 AA          '..'
ZF8BD   CPX     M009F                    ;F8BD: 9C 9F          '..'
        BLS     ZF8C5                    ;F8BF: 23 04          '#.'
        STX     M009F                    ;F8C1: DF 9F          '..'
        STAA    M00A1                    ;F8C3: 97 A1          '..'
ZF8C5   LDX     M0090                    ;F8C5: DE 90          '..'
        CPX     M00AB                    ;F8C7: 9C AB          '..'
        BCC     ZF8CF                    ;F8C9: 24 04          '$.'
        STX     M00AB                    ;F8CB: DF AB          '..'
        STAA    M00AD                    ;F8CD: 97 AD          '..'
ZF8CF   CPX     M00A2                    ;F8CF: 9C A2          '..'
        BLS     ZF8D7                    ;F8D1: 23 04          '#.'
        STX     M00A2                    ;F8D3: DF A2          '..'
        STAA    M00A4                    ;F8D5: 97 A4          '..'
ZF8D7   LDX     M0093                    ;F8D7: DE 93          '..'
        CPX     M00AE                    ;F8D9: 9C AE          '..'
        BCC     ZF8E1                    ;F8DB: 24 04          '$.'
        STX     M00AE                    ;F8DD: DF AE          '..'
        STAA    M00B0                    ;F8DF: 97 B0          '..'
ZF8E1   CPX     M00A5                    ;F8E1: 9C A5          '..'
        BLS     ZF8E9                    ;F8E3: 23 04          '#.'
        STX     M00A5                    ;F8E5: DF A5          '..'
        STAA    M00A7                    ;F8E7: 97 A7          '..'
ZF8E9   CLR     >M00D8                   ;F8E9: 7F 00 D8       '...'
        LDD     M0099                    ;F8EC: DC 99          '..'
        SUBD    M0093                    ;F8EE: 93 93          '..'
        ROL     >M00D8                   ;F8F0: 79 00 D8       'y..'
        LDD     M0093                    ;F8F3: DC 93          '..'
        ASLD                             ;F8F5: 05             '.'
        SUBD    M0096                    ;F8F6: 93 96          '..'
        SUBD    M0099                    ;F8F8: 93 99          '..'
        ROL     >M00D8                   ;F8FA: 79 00 D8       'y..'
ZF8FD   RTI                              ;F8FD: 3B             ';'
ZF8FE   LDD     M00CD                    ;F8FE: DC CD          '..'
        ADDD    M008D                    ;F900: D3 8D          '..'
        STD     M00CD                    ;F902: DD CD          '..'
        BCC     ZF909                    ;F904: 24 03          '$.'
        INC     >M00CC                   ;F906: 7C 00 CC       '|..'
ZF909   LDD     M00D0                    ;F909: DC D0          '..'
        ADDD    M0090                    ;F90B: D3 90          '..'
        STD     M00D0                    ;F90D: DD D0          '..'
        BCC     ZF914                    ;F90F: 24 03          '$.'
        INC     >M00CF                   ;F911: 7C 00 CF       '|..'
ZF914   LDD     M00D3                    ;F914: DC D3          '..'
        ADDD    M0093                    ;F916: D3 93          '..'
        STD     M00D3                    ;F918: DD D3          '..'
        BCC     ZF91F                    ;F91A: 24 03          '$.'
        INC     >M00D2                   ;F91C: 7C 00 D2       '|..'
ZF91F   INC     >M009E                   ;F91F: 7C 00 9E       '|..'
        LDAA    M0098                    ;F922: 96 98          '..'
        INCA                             ;F924: 4C             'L'
        CMPA    #$90                     ;F925: 81 90          '..'
        BCC     ZF98A                    ;F927: 24 61          '$a'
        STAA    M0098                    ;F929: 97 98          '..'
        CMPA    #$0C                     ;F92B: 81 0C          '..'
        BNE     ZF8FD                    ;F92D: 26 CE          '&.'
        LDAA    M0002                    ;F92F: 96 02          '..'
        BITA    #$20                     ;F931: 85 20          '. '
        BNE     ZF8FD                    ;F933: 26 C8          '&.'
        LDAA    M00C8                    ;F935: 96 C8          '..'
        CMPA    #$0A                     ;F937: 81 0A          '..'
        BEQ     ZF953                    ;F939: 27 18          ''.'
        CMPA    #$04                     ;F93B: 81 04          '..'
        BNE     ZF8FD                    ;F93D: 26 BE          '&.'
        LDAA    M00C5                    ;F93F: 96 C5          '..'
        LSRA                             ;F941: 44             'D'
        SUBA    #$18                     ;F942: 80 18          '..'
        BCS     ZF8FD                    ;F944: 25 B7          '%.'
        ADDA    #$02                     ;F946: 8B 02          '..'
        BSR     ZF96C                    ;F948: 8D 22          '."'
        BNE     ZF8FD                    ;F94A: 26 B1          '&.'
        LDAA    M0098                    ;F94C: 96 98          '..'
        ADDA    #$06                     ;F94E: 8B 06          '..'
        STAA    M0098                    ;F950: 97 98          '..'
        RTI                              ;F952: 3B             ';'
ZF953   LDAA    M00C5                    ;F953: 96 C5          '..'
        LSRA                             ;F955: 44             'D'
        BCS     ZF8FD                    ;F956: 25 A5          '%.'
        SUBA    #$19                     ;F958: 80 19          '..'
        BCS     ZF8FD                    ;F95A: 25 A1          '%.'
        ADDA    #$04                     ;F95C: 8B 04          '..'
        BSR     ZF96C                    ;F95E: 8D 0C          '..'
        BNE     ZF8FD                    ;F960: 26 9B          '&.'
        LDAA    M0098                    ;F962: 96 98          '..'
        SUBA    #$06                     ;F964: 80 06          '..'
        STAA    M0098                    ;F966: 97 98          '..'
        INC     >M00C5                   ;F968: 7C 00 C5       '|..'
        RTI                              ;F96B: 3B             ';'
ZF96C   LDAB    M009B                    ;F96C: D6 9B          '..'
        ANDB    #$03                     ;F96E: C4 03          '..'
        ABA                              ;F970: 1B             '.'
        LDAB    M009B                    ;F971: D6 9B          '..'
        LSRB                             ;F973: 54             'T'
        LSRB                             ;F974: 54             'T'
ZF975   CMPB    #$1D                     ;F975: C1 1D          '..'
        BCS     ZF97F                    ;F977: 25 06          '%.'
        ADDA    #$05                     ;F979: 8B 05          '..'
        SUBB    #$19                     ;F97B: C0 19          '..'
        BRA     ZF975                    ;F97D: 20 F6          ' .'
ZF97F   PSHA                             ;F97F: 36             '6'
        LDAA    #$05                     ;F980: 86 05          '..'
        MUL                              ;F982: 3D             '='
        PULA                             ;F983: 32             '2'
        ABA                              ;F984: 1B             '.'
ZF985   SUBA    #$07                     ;F985: 80 07          '..'
        BHI     ZF985                    ;F987: 22 FC          '".'
        RTS                              ;F989: 39             '9'
ZF98A   BSR     ZF9CF                    ;F98A: 8D 43          '.C'
        LDAA    M00C5                    ;F98C: 96 C5          '..'
        LSRA                             ;F98E: 44             'D'
        CBA                              ;F98F: 11             '.'
        BCS     ZF9A6                    ;F990: 25 14          '%.'
        LDAA    M00C8                    ;F992: 96 C8          '..'
        CMPA    #$0C                     ;F994: 81 0C          '..'
        BCS     ZF9A2                    ;F996: 25 0A          '%.'
        INC     >M009B                   ;F998: 7C 00 9B       '|..'
        BNE     ZF9A1                    ;F99B: 26 04          '&.'
        LDAA    #$08                     ;F99D: 86 08          '..'
        STAA    M009B                    ;F99F: 97 9B          '..'
ZF9A1   CLRA                             ;F9A1: 4F             'O'
ZF9A2   INCA                             ;F9A2: 4C             'L'
        STAA    M00C8                    ;F9A3: 97 C8          '..'
        CLRA                             ;F9A5: 4F             'O'
ZF9A6   INCA                             ;F9A6: 4C             'L'
        ASLA                             ;F9A7: 48             'H'
        STAA    M00C5                    ;F9A8: 97 C5          '..'
        LDX     #M00CC                   ;F9AA: CE 00 CC       '...'
        BSR     ZF9F7                    ;F9AD: 8D 48          '.H'
        STD     M00C3                    ;F9AF: DD C3          '..'
        LDX     #M00CF                   ;F9B1: CE 00 CF       '...'
        BSR     ZF9F7                    ;F9B4: 8D 41          '.A'
        STD     M00C6                    ;F9B6: DD C6          '..'
        LDX     #M00D2                   ;F9B8: CE 00 D2       '...'
        BSR     ZF9F7                    ;F9BB: 8D 3A          '.:'
        STD     M00C9                    ;F9BD: DD C9          '..'
        LDX     #M0012                   ;F9BF: CE 00 12       '...'
ZF9C2   LDAA    $9E,X                    ;F9C2: A6 9E          '..'
        STAA    $B0,X                    ;F9C4: A7 B0          '..'
        DEX                              ;F9C6: 09             '.'
        BNE     ZF9C2                    ;F9C7: 26 F9          '&.'
        CLR     >M0098                   ;F9C9: 7F 00 98       '...'
        BSR     ZFA1D                    ;F9CC: 8D 4F          '.O'
hdlr_SWI RTI                              ;F9CE: 3B             ';'
ZF9CF   LDAB    M00C8                    ;F9CF: D6 C8          '..'
        LDX     #ZF9EA                   ;F9D1: CE F9 EA       '...'
        ABX                              ;F9D4: 3A             ':'
        LDAB    ,X                       ;F9D5: E6 00          '..'
        CMPB    #$1C                     ;F9D7: C1 1C          '..'
        BNE     ZF9EA                    ;F9D9: 26 0F          '&.'
        LDAA    M009B                    ;F9DB: 96 9B          '..'
        BITA    #$03                     ;F9DD: 85 03          '..'
        BNE     ZF9EA                    ;F9DF: 26 09          '&.'
        CMPA    #$74                     ;F9E1: 81 74          '.t'
        BEQ     ZF9EA                    ;F9E3: 27 05          ''.'
        CMPA    #$D8                     ;F9E5: 81 D8          '..'
        BEQ     ZF9EA                    ;F9E7: 27 01          ''.'
        INCB                             ;F9E9: 5C             '\'
ZF9EA   RTS                              ;F9EA: 39             '9'
        FCB     $1F                      ;F9EB: 1F             '.'
        FCB     $1C                      ;F9EC: 1C             '.'
        FCB     $1F                      ;F9ED: 1F             '.'
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        FCB     $1F                      ;F9F6: 1F             '.'
ZF9F7   LDAA    #$11                     ;F9F7: 86 11          '..'
        PSHA                             ;F9F9: 36             '6'
        LDAA    $02,X                    ;F9FA: A6 02          '..'
        PSHA                             ;F9FC: 36             '6'
        LDD     ,X                       ;F9FD: EC 00          '..'
        TSX                              ;F9FF: 30             '0'
        CLC                              ;FA00: 0C             '.'
ZFA01   ROL     ,X                       ;FA01: 69 00          'i.'
        ROLB                             ;FA03: 59             'Y'
        ROLA                             ;FA04: 49             'I'
        BCS     ZFA0B                    ;FA05: 25 04          '%.'
        CMPA    M009E                    ;FA07: 91 9E          '..'
        BCS     ZFA0E                    ;FA09: 25 03          '%.'
ZFA0B   SUBA    M009E                    ;FA0B: 90 9E          '..'
        CLC                              ;FA0D: 0C             '.'
ZFA0E   DEC     $01,X                    ;FA0E: 6A 01          'j.'
        BNE     ZFA01                    ;FA10: 26 EF          '&.'
        TBA                              ;FA12: 17             '.'
        PULB                             ;FA13: 33             '3'
        INS                              ;FA14: 31             '1'
        BCS     ZFA1A                    ;FA15: 25 03          '%.'
        SUBD    #M0001                   ;FA17: 83 00 01       '...'
ZFA1A   COMA                             ;FA1A: 43             'C'
        COMB                             ;FA1B: 53             'S'
        RTS                              ;FA1C: 39             '9'
ZFA1D   LDD     M008D                    ;FA1D: DC 8D          '..'
        STD     M00CD                    ;FA1F: DD CD          '..'
        STD     M009F                    ;FA21: DD 9F          '..'
        STD     M00A8                    ;FA23: DD A8          '..'
        LDD     M0090                    ;FA25: DC 90          '..'
        STD     M00D0                    ;FA27: DD D0          '..'
        STD     M00A2                    ;FA29: DD A2          '..'
        STD     M00AB                    ;FA2B: DD AB          '..'
        LDD     M0093                    ;FA2D: DC 93          '..'
        STD     M00D3                    ;FA2F: DD D3          '..'
        STD     M00A5                    ;FA31: DD A5          '..'
        STD     M00AE                    ;FA33: DD AE          '..'
        LDAA    M0098                    ;FA35: 96 98          '..'
        STAA    M00A1                    ;FA37: 97 A1          '..'
        STAA    M00AA                    ;FA39: 97 AA          '..'
        STAA    M00A4                    ;FA3B: 97 A4          '..'
        STAA    M00AD                    ;FA3D: 97 AD          '..'
        STAA    M00A7                    ;FA3F: 97 A7          '..'
        STAA    M00B0                    ;FA41: 97 B0          '..'
        CLRA                             ;FA43: 4F             'O'
        STAA    M00CC                    ;FA44: 97 CC          '..'
        STAA    M00CF                    ;FA46: 97 CF          '..'
        STAA    M00D2                    ;FA48: 97 D2          '..'
        INCA                             ;FA4A: 4C             'L'
        STAA    M009E                    ;FA4B: 97 9E          '..'
        RTS                              ;FA4D: 39             '9'
ZFA4E   LDD     M00D5                    ;FA4E: DC D5          '..'
        JSR     ZFC12                    ;FA50: BD FC 12       '...'
        LSRA                             ;FA53: 44             'D'
        BCS     ZFA77                    ;FA54: 25 21          '%!'
        LSRA                             ;FA56: 44             'D'
        BCS     ZFA6B                    ;FA57: 25 12          '%.'
        BEQ     ZFA4E                    ;FA59: 27 F3          ''.'
        LDAA    M00D5                    ;FA5B: 96 D5          '..'
        ADDA    #$04                     ;FA5D: 8B 04          '..'
        CMPA    #$1C                     ;FA5F: 81 1C          '..'
        BCS     ZFA65                    ;FA61: 25 02          '%.'
        ANDA    #$03                     ;FA63: 84 03          '..'
ZFA65   ANDA    #$FD                     ;FA65: 84 FD          '..'
        STAA    M00D5                    ;FA67: 97 D5          '..'
        BRA     ZFA4E                    ;FA69: 20 E3          ' .'
ZFA6B   LDAB    M00D6                    ;FA6B: D6 D6          '..'
        INCB                             ;FA6D: 5C             '\'
        CMPB    #$02                     ;FA6E: C1 02          '..'
        BLS     ZFA73                    ;FA70: 23 01          '#.'
        CLRB                             ;FA72: 5F             '_'
ZFA73   STAB    M00D6                    ;FA73: D7 D6          '..'
        BRA     ZFA4E                    ;FA75: 20 D7          ' .'
ZFA77   LDAB    M00D5                    ;FA77: D6 D5          '..'
ZFA79   INCB                             ;FA79: 5C             '\'
        BITB    #$03                     ;FA7A: C5 03          '..'
        BEQ     ZFA94                    ;FA7C: 27 16          ''.'
        BITB    #$02                     ;FA7E: C5 02          '..'
        BEQ     ZFA96                    ;FA80: 27 14          ''.'
        BITB    #$FC                     ;FA82: C5 FC          '..'
        BEQ     ZFA96                    ;FA84: 27 10          ''.'
        BITB    #$01                     ;FA86: C5 01          '..'
        BNE     ZFA79                    ;FA88: 26 EF          '&.'
        CMPB    #$0E                     ;FA8A: C1 0E          '..'
        BEQ     ZFA79                    ;FA8C: 27 EB          ''.'
        CMPB    #$1A                     ;FA8E: C1 1A          '..'
        BEQ     ZFA79                    ;FA90: 27 E7          ''.'
        BRA     ZFA96                    ;FA92: 20 02          ' .'
ZFA94   SUBB    #$04                     ;FA94: C0 04          '..'
ZFA96   STAB    M00D5                    ;FA96: D7 D5          '..'
        BRA     ZFA4E                    ;FA98: 20 B4          ' .'
ZFA9A   LDD     M00D5                    ;FA9A: DC D5          '..'
        JSR     ZFC12                    ;FA9C: BD FC 12       '...'
        LSRA                             ;FA9F: 44             'D'
        BCS     ZFAB6                    ;FAA0: 25 14          '%.'
        LSRA                             ;FAA2: 44             'D'
        BCS     ZFAD1                    ;FAA3: 25 2C          '%,'
        LSRA                             ;FAA5: 44             'D'
        BCS     ZFA4E                    ;FAA6: 25 A6          '%.'
        BITB    #$01                     ;FAA8: C5 01          '..'
        BNE     ZFA9A                    ;FAAA: 26 EE          '&.'
ZFAAC   LDAA    M0092                    ;FAAC: 96 92          '..'
        CMPA    #$31                     ;FAAE: 81 31          '.1'
        BEQ     ZFAB6                    ;FAB0: 27 04          ''.'
        CMPA    #$6D                     ;FAB2: 81 6D          '.m'
        BNE     ZFA9A                    ;FAB4: 26 E4          '&.'
ZFAB6   LDAA    M00D5                    ;FAB6: 96 D5          '..'
        INCA                             ;FAB8: 4C             'L'
ZFAB9   ANDA    #$03                     ;FAB9: 84 03          '..'
        STAA    M00D5                    ;FABB: 97 D5          '..'
        LDAB    M00CB                    ;FABD: D6 CB          '..'
        ASLB                             ;FABF: 58             'X'
        ASLB                             ;FAC0: 58             'X'
        ASLB                             ;FAC1: 58             'X'
        ASLB                             ;FAC2: 58             'X'
        BEQ     ZFADD                    ;FAC3: 27 18          ''.'
ZFAC5   ASLB                             ;FAC5: 58             'X'
        DECA                             ;FAC6: 4A             'J'
        BPL     ZFAC5                    ;FAC7: 2A FC          '*.'
        BCC     ZFAB6                    ;FAC9: 24 EB          '$.'
        BRA     ZFA9A                    ;FACB: 20 CD          ' .'
ZFACD   LDAA    M00D5                    ;FACD: 96 D5          '..'
        BRA     ZFAB9                    ;FACF: 20 E8          ' .'
ZFAD1   LDAA    M00D6                    ;FAD1: 96 D6          '..'
        INCA                             ;FAD3: 4C             'L'
        CMPA    #$03                     ;FAD4: 81 03          '..'
        BCS     ZFAD9                    ;FAD6: 25 01          '%.'
        CLRA                             ;FAD8: 4F             'O'
ZFAD9   STAA    M00D6                    ;FAD9: 97 D6          '..'
        BRA     ZFAAC                    ;FADB: 20 CF          ' .'
ZFADD   DEC     >M00CB                   ;FADD: 7A 00 CB       'z..'
        BRA     ZFA9A                    ;FAE0: 20 B8          ' .'
ZFAE2   LDD     #M070B                   ;FAE2: CC 07 0B       '...'
        JSR     ZFC12                    ;FAE5: BD FC 12       '...'
        LSRA                             ;FAE8: 44             'D'
        BCS     ZFAFB                    ;FAE9: 25 10          '%.'
        LSRA                             ;FAEB: 44             'D'
        BCS     ZFAF6                    ;FAEC: 25 08          '%.'
        LSRA                             ;FAEE: 44             'D'
        BCC     ZFAE2                    ;FAEF: 24 F1          '$.'
        DEC     >M009B                   ;FAF1: 7A 00 9B       'z..'
        BRA     ZFAE2                    ;FAF4: 20 EC          ' .'
ZFAF6   INC     >M009B                   ;FAF6: 7C 00 9B       '|..'
        BRA     ZFAE2                    ;FAF9: 20 E7          ' .'
ZFAFB   LDD     #M033B                   ;FAFB: CC 03 3B       '..;'
        JSR     ZFC12                    ;FAFE: BD FC 12       '...'
        LDAB    M00C8                    ;FB01: D6 C8          '..'
        SUBB    #$0B                     ;FB03: C0 0B          '..'
        LSRA                             ;FB05: 44             'D'
        BCS     ZFB19                    ;FB06: 25 11          '%.'
        LSRA                             ;FB08: 44             'D'
        BCS     ZFB10                    ;FB09: 25 05          '%.'
        LSRA                             ;FB0B: 44             'D'
        BCC     ZFAFB                    ;FB0C: 24 ED          '$.'
        ADDB    #$0A                     ;FB0E: CB 0A          '..'
ZFB10   TSTB                             ;FB10: 5D             ']'
        BGT     ZFB15                    ;FB11: 2E 02          '..'
        ADDB    #$0C                     ;FB13: CB 0C          '..'
ZFB15   STAB    M00C8                    ;FB15: D7 C8          '..'
        BRA     ZFAFB                    ;FB17: 20 E2          ' .'
ZFB19   JSR     ZF9CF                    ;FB19: BD F9 CF       '...'
        LDAA    M00C5                    ;FB1C: 96 C5          '..'
        LSRA                             ;FB1E: 44             'D'
        BEQ     ZFB3A                    ;FB1F: 27 19          ''.'
        SBA                              ;FB21: 10             '.'
        TAB                              ;FB22: 16             '.'
        BGT     ZFB3A                    ;FB23: 2E 15          '..'
        LDD     #M03CB                   ;FB25: CC 03 CB       '...'
        JSR     ZFC12                    ;FB28: BD FC 12       '...'
        LDAB    M00C5                    ;FB2B: D6 C5          '..'
        LSRB                             ;FB2D: 54             'T'
        LSRA                             ;FB2E: 44             'D'
        BCS     ZFB3F                    ;FB2F: 25 0E          '%.'
        LSRA                             ;FB31: 44             'D'
        BCS     ZFB39                    ;FB32: 25 05          '%.'
        LSRA                             ;FB34: 44             'D'
        BCC     ZFB19                    ;FB35: 24 E2          '$.'
        DECB                             ;FB37: 5A             'Z'
        DECB                             ;FB38: 5A             'Z'
ZFB39   INCB                             ;FB39: 5C             '\'
ZFB3A   ASLB                             ;FB3A: 58             'X'
        STAB    M00C5                    ;FB3B: D7 C5          '..'
        BRA     ZFB19                    ;FB3D: 20 DA          ' .'
ZFB3F   LDD     #M023B                   ;FB3F: CC 02 3B       '..;'
        JSR     ZFC12                    ;FB42: BD FC 12       '...'
        LDAB    M0098                    ;FB45: D6 98          '..'
        LSRA                             ;FB47: 44             'D'
        BCS     ZFB67                    ;FB48: 25 1D          '%.'
        LSRA                             ;FB4A: 44             'D'
        BCS     ZFB58                    ;FB4B: 25 0B          '%.'
        LSRA                             ;FB4D: 44             'D'
        BCC     ZFB3F                    ;FB4E: 24 EF          '$.'
        SUBB    #$06                     ;FB50: C0 06          '..'
        BCC     ZFB60                    ;FB52: 24 0C          '$.'
        ADDB    #$90                     ;FB54: CB 90          '..'
        BRA     ZFB60                    ;FB56: 20 08          ' .'
ZFB58   ADDB    #$06                     ;FB58: CB 06          '..'
        CMPB    #$90                     ;FB5A: C1 90          '..'
        BCS     ZFB60                    ;FB5C: 25 02          '%.'
        SUBB    #$90                     ;FB5E: C0 90          '..'
ZFB60   STAB    M0098                    ;FB60: D7 98          '..'
        JSR     ZFA1D                    ;FB62: BD FA 1D       '...'
        BRA     ZFB3F                    ;FB65: 20 D8          ' .'
ZFB67   LDD     #M02DB                   ;FB67: CC 02 DB       '...'
        JSR     ZFC12                    ;FB6A: BD FC 12       '...'
        LDAB    M0098                    ;FB6D: D6 98          '..'
ZFB6F   SUBB    #$06                     ;FB6F: C0 06          '..'
        BCC     ZFB6F                    ;FB71: 24 FC          '$.'
        LSRA                             ;FB73: 44             'D'
        BCS     ZFB96                    ;FB74: 25 20          '% '
        LSRA                             ;FB76: 44             'D'
        BCS     ZFB86                    ;FB77: 25 0D          '%.'
        LSRA                             ;FB79: 44             'D'
        BCC     ZFB67                    ;FB7A: 24 EB          '$.'
        LDAA    #$FF                     ;FB7C: 86 FF          '..'
        CMPB    #$FA                     ;FB7E: C1 FA          '..'
        BNE     ZFB8D                    ;FB80: 26 0B          '&.'
        LDAA    #$05                     ;FB82: 86 05          '..'
        BRA     ZFB8D                    ;FB84: 20 07          ' .'
ZFB86   LDAA    #$01                     ;FB86: 86 01          '..'
        INCB                             ;FB88: 5C             '\'
        BNE     ZFB8D                    ;FB89: 26 02          '&.'
        LDAA    #$FB                     ;FB8B: 86 FB          '..'
ZFB8D   ADDA    M0098                    ;FB8D: 9B 98          '..'
        STAA    M0098                    ;FB8F: 97 98          '..'
        JSR     ZFA1D                    ;FB91: BD FA 1D       '...'
        BRA     ZFB67                    ;FB94: 20 D1          ' .'
ZFB96   LDD     #M02EB                   ;FB96: CC 02 EB       '...'
        BSR     ZFC12                    ;FB99: 8D 77          '.w'
        LSRA                             ;FB9B: 44             'D'
        BCS     ZFBC5                    ;FB9C: 25 27          '%''
        BITA    #$03                     ;FB9E: 85 03          '..'
        BEQ     ZFB96                    ;FBA0: 27 F4          ''.'
ZFBA2   LDAB    M0095                    ;FBA2: D6 95          '..'
        LSRA                             ;FBA4: 44             'D'
        BCS     ZFBAE                    ;FBA5: 25 07          '%.'
        LSRA                             ;FBA7: 44             'D'
        BCC     ZFBB6                    ;FBA8: 24 0C          '$.'
        ADDB    #$90                     ;FBAA: CB 90          '..'
        BRA     ZFBB0                    ;FBAC: 20 02          ' .'
ZFBAE   ADDB    #$10                     ;FBAE: CB 10          '..'
ZFBB0   TBA                              ;FBB0: 17             '.'
        DAA                              ;FBB1: 19             '.'
        ANDA    #$F0                     ;FBB2: 84 F0          '..'
        STAA    M0095                    ;FBB4: 97 95          '..'
ZFBB6   LDAA    #$78                     ;FBB6: 86 78          '.x'
        STAA    M0092                    ;FBB8: 97 92          '..'
        LDD     #M02EB                   ;FBBA: CC 02 EB       '...'
        BSR     ZFC12                    ;FBBD: 8D 53          '.S'
        LSRA                             ;FBBF: 44             'D'
        BCC     ZFBA2                    ;FBC0: 24 E0          '$.'
ZFBC2   JMP     ZFA4E                    ;FBC2: 7E FA 4E       '~.N'
ZFBC5   LDAA    #$A0                     ;FBC5: 86 A0          '..'
        BSR     ZFC12                    ;FBC7: 8D 49          '.I'
        LDAB    M00CB                    ;FBC9: D6 CB          '..'
        LSRA                             ;FBCB: 44             'D'
        BCS     ZFBC2                    ;FBCC: 25 F4          '%.'
        LSRA                             ;FBCE: 44             'D'
        BCS     ZFBDB                    ;FBCF: 25 0A          '%.'
        LSRA                             ;FBD1: 44             'D'
        BCC     ZFBC5                    ;FBD2: 24 F1          '$.'
ZFBD4   DECB                             ;FBD4: 5A             'Z'
        BSR     ZFBE4                    ;FBD5: 8D 0D          '..'
        BEQ     ZFBD4                    ;FBD7: 27 FB          ''.'
        BRA     ZFBE0                    ;FBD9: 20 05          ' .'
ZFBDB   INCB                             ;FBDB: 5C             '\'
        BSR     ZFBE4                    ;FBDC: 8D 06          '..'
        BEQ     ZFBDB                    ;FBDE: 27 FB          ''.'
ZFBE0   STAB    M00CB                    ;FBE0: D7 CB          '..'
        BRA     ZFBC5                    ;FBE2: 20 E1          ' .'
ZFBE4   ANDB    #$0F                     ;FBE4: C4 0F          '..'
        BEQ     ZFBED                    ;FBE6: 27 05          ''.'
        PSHB                             ;FBE8: 37             '7'
ZFBE9   LSRB                             ;FBE9: 54             'T'
        BCC     ZFBE9                    ;FBEA: 24 FD          '$.'
        PULB                             ;FBEC: 33             '3'
ZFBED   RTS                              ;FBED: 39             '9'
ZFBEE   LDAB    M0080                    ;FBEE: D6 80          '..'
        ANDB    #$7F                     ;FBF0: C4 7F          '..'
        STAB    M0080                    ;FBF2: D7 80          '..'
        LDAA    #$90                     ;FBF4: 86 90          '..'
        CMPB    #$08                     ;FBF6: C1 08          '..'
        BNE     ZFBFD                    ;FBF8: 26 03          '&.'
        LDD     #MC000                   ;FBFA: CC C0 00       '...'
ZFBFD   BSR     ZFC12                    ;FBFD: 8D 13          '..'
        LSRA                             ;FBFF: 44             'D'
        BCS     ZFBC2                    ;FC00: 25 C0          '%.'
        LSRA                             ;FC02: 44             'D'
        BCS     ZFC0D                    ;FC03: 25 08          '%.'
        LSRA                             ;FC05: 44             'D'
        BCC     ZFBEE                    ;FC06: 24 E6          '$.'
        DEC     >M0080                   ;FC08: 7A 00 80       'z..'
        BRA     ZFBEE                    ;FC0B: 20 E1          ' .'
ZFC0D   INC     >M0080                   ;FC0D: 7C 00 80       '|..'
        BRA     ZFBEE                    ;FC10: 20 DC          ' .'
ZFC12   TSTA                             ;FC12: 4D             'M'
        BPL     ZFC5D                    ;FC13: 2A 48          '*H'
        ASLA                             ;FC15: 48             'H'
        BPL     ZFC24                    ;FC16: 2A 0C          '*.'
        LDD     #MFFFF                   ;FC18: CC FF FF       '...'
        STD     M0085                    ;FC1B: DD 85          '..'
        STD     M0087                    ;FC1D: DD 87          '..'
        STD     M0089                    ;FC1F: DD 89          '..'
        JMP     ZFD7E                    ;FC21: 7E FD 7E       '~.~'
ZFC24   ASLA                             ;FC24: 48             'H'
        BPL     ZFC3F                    ;FC25: 2A 18          '*.'
        LDD     #MD456                   ;FC27: CC D4 56       '..V'
        STD     M00DD                    ;FC2A: DD DD          '..'
        LDD     #M7AEA                   ;FC2C: CC 7A EA       '.z.'
        STD     M00DF                    ;FC2F: DD DF          '..'
        LDD     #M60F8                   ;FC31: CC 60 F8       '.`.'
        STD     M00E1                    ;FC34: DD E1          '..'
        LDAB    M00CB                    ;FC36: D6 CB          '..'
        COMB                             ;FC38: 53             'S'
        LDAA    #$10                     ;FC39: 86 10          '..'
        MUL                              ;FC3B: 3D             '='
        JMP     ZFD4C                    ;FC3C: 7E FD 4C       '~.L'
ZFC3F   LDAB    M0080                    ;FC3F: D6 80          '..'
        ORAB    #$80                     ;FC41: CA 80          '..'
        PSHB                             ;FC43: 37             '7'
        JSR     ZFEA8                    ;FC44: BD FE A8       '...'
        STD     M0085                    ;FC47: DD 85          '..'
        PULB                             ;FC49: 33             '3'
        LDX     #M0000                   ;FC4A: CE 00 00       '...'
        ABX                              ;FC4D: 3A             ':'
        LDAB    ,X                       ;FC4E: E6 00          '..'
        JSR     ZFEA8                    ;FC50: BD FE A8       '...'
        STD     M0087                    ;FC53: DD 87          '..'
        LDD     #M3FFF                   ;FC55: CC 3F FF       '.?.'
        STD     M0089                    ;FC58: DD 89          '..'
        JMP     ZFD7E                    ;FC5A: 7E FD 7E       '~.~'
ZFC5D   PSHB                             ;FC5D: 37             '7'
        LSRA                             ;FC5E: 44             'D'
        ROR     >M00DD                   ;FC5F: 76 00 DD       'v..'
        LSRA                             ;FC62: 44             'D'
        BCS     ZFC91                    ;FC63: 25 2C          '%,'
        JSR     ZFDB5                    ;FC65: BD FD B5       '...'
        LDAB    #$80                     ;FC68: C6 80          '..'
        LDAA    M00DD                    ;FC6A: 96 DD          '..'
        BPL     ZFC70                    ;FC6C: 2A 02          '*.'
        LDAB    #$40                     ;FC6E: C6 40          '.@'
ZFC70   STAB    M00E2                    ;FC70: D7 E2          '..'
        CPX     #M00CC                   ;FC72: 8C 00 CC       '...'
        BCS     ZFC84                    ;FC75: 25 0D          '%.'
        CPX     #M00D2                   ;FC77: 8C 00 D2       '...'
        BHI     ZFC84                    ;FC7A: 22 08          '".'
        JSR     ZF9F7                    ;FC7C: BD F9 F7       '...'
        LDX     #M00DB                   ;FC7F: CE 00 DB       '...'
        STD     ,X                       ;FC82: ED 00          '..'
ZFC84   JSR     ZFDCA                    ;FC84: BD FD CA       '...'
        JSR     ZFE58                    ;FC87: BD FE 58       '..X'
        INC     >M00DF                   ;FC8A: 7C 00 DF       '|..'
        PULB                             ;FC8D: 33             '3'
        JMP     ZFD4C                    ;FC8E: 7E FD 4C       '~.L'
ZFC91   TST     >M00DD                   ;FC91: 7D 00 DD       '}..'
        BPL     ZFCC2                    ;FC94: 2A 2C          '*,'
        TSTA                             ;FC96: 4D             'M'
        BEQ     ZFCAC                    ;FC97: 27 13          ''.'
        LDD     #M07C0                   ;FC99: CC 07 C0       '...'
        ADDB    M009B                    ;FC9C: DB 9B          '..'
        ADCA    #$00                     ;FC9E: 89 00          '..'
        JSR     ZFE58                    ;FCA0: BD FE 58       '..X'
        LDD     #M0008                   ;FCA3: CC 00 08       '...'
        STD     M00E1                    ;FCA6: DD E1          '..'
        PULB                             ;FCA8: 33             '3'
        JMP     ZFD4C                    ;FCA9: 7E FD 4C       '~.L'
ZFCAC   LDAB    M00C8                    ;FCAC: D6 C8          '..'
        JSR     ZFE34                    ;FCAE: BD FE 34       '..4'
        STD     M00DD                    ;FCB1: DD DD          '..'
        LDAB    M00C5                    ;FCB3: D6 C5          '..'
        LSRB                             ;FCB5: 54             'T'
        JSR     ZFE34                    ;FCB6: BD FE 34       '..4'
        LDD     #M2008                   ;FCB9: CC 20 08       '. .'
        STD     M00E1                    ;FCBC: DD E1          '..'
        PULB                             ;FCBE: 33             '3'
        JMP     ZFD4C                    ;FCBF: 7E FD 4C       '~.L'
ZFCC2   JSR     ZFDB5                    ;FCC2: BD FD B5       '...'
        LDAA    $02,X                    ;FCC5: A6 02          '..'
        CLRB                             ;FCC7: 5F             '_'
        CPX     #M009C                   ;FCC8: 8C 00 9C       '...'
        BCC     ZFCD1                    ;FCCB: 24 04          '$.'
        LDAA    M0098                    ;FCCD: 96 98          '..'
        LDAB    M0095                    ;FCCF: D6 95          '..'
ZFCD1   LSRB                             ;FCD1: 54             'T'
        LSRB                             ;FCD2: 54             'T'
        LSRB                             ;FCD3: 54             'T'
        LSRB                             ;FCD4: 54             'T'
        STD     M00D9                    ;FCD5: DD D9          '..'
        BNE     ZFCE1                    ;FCD7: 26 08          '&.'
        LDAB    M0002                    ;FCD9: D6 02          '..'
        BITB    #$40                     ;FCDB: C5 40          '.@'
        BEQ     ZFCE1                    ;FCDD: 27 02          ''.'
        LDAA    #$90                     ;FCDF: 86 90          '..'
ZFCE1   LDAB    #$AB                     ;FCE1: C6 AB          '..'
        MUL                              ;FCE3: 3D             '='
        LSRD                             ;FCE4: 04             '.'
        LSRD                             ;FCE5: 04             '.'
        STAB    M00D9                    ;FCE6: D7 D9          '..'
        LDAB    M0002                    ;FCE8: D6 02          '..'
        BITB    #$40                     ;FCEA: C5 40          '.@'
        BEQ     ZFCF6                    ;FCEC: 27 08          ''.'
        SEC                              ;FCEE: 0D             '.'
        ROL     >M00DA                   ;FCEF: 79 00 DA       'y..'
        LDAB    #$FC                     ;FCF2: C6 FC          '..'
        BRA     ZFD08                    ;FCF4: 20 12          ' .'
ZFCF6   CMPA    #$0C                     ;FCF6: 81 0C          '..'
        BCS     ZFCFC                    ;FCF8: 25 02          '%.'
        SUBA    #$0C                     ;FCFA: 80 0C          '..'
ZFCFC   ROL     >M00DA                   ;FCFC: 79 00 DA       'y..'
        ROL     >M00DA                   ;FCFF: 79 00 DA       'y..'
        TSTA                             ;FD02: 4D             'M'
        BNE     ZFD07                    ;FD03: 26 02          '&.'
        LDAA    #$0C                     ;FD05: 86 0C          '..'
ZFD07   CLRB                             ;FD07: 5F             '_'
ZFD08   SUBA    #$0A                     ;FD08: 80 0A          '..'
        BCS     ZFD16                    ;FD0A: 25 0A          '%.'
        LDAB    #$28                     ;FD0C: C6 28          '.('
        SUBA    #$0A                     ;FD0E: 80 0A          '..'
        BCS     ZFD16                    ;FD10: 25 04          '%.'
        LDAB    #$E6                     ;FD12: C6 E6          '..'
        SUBA    #$0A                     ;FD14: 80 0A          '..'
ZFD16   STAB    M00DD                    ;FD16: D7 DD          '..'
        TAB                              ;FD18: 16             '.'
        LDX     #MFDC7                   ;FD19: CE FD C7       '...'
        ABX                              ;FD1C: 3A             ':'
        LDAB    ,X                       ;FD1D: E6 00          '..'
        STAB    M00DE                    ;FD1F: D7 DE          '..'
        LDAB    M00D9                    ;FD21: D6 D9          '..'
        LDAA    #$06                     ;FD23: 86 06          '..'
        INCB                             ;FD25: 5C             '\'
        MUL                              ;FD26: 3D             '='
        TAB                              ;FD27: 16             '.'
        LDX     #MFEBD                   ;FD28: CE FE BD       '...'
        ABX                              ;FD2B: 3A             ':'
        LDAB    ,X                       ;FD2C: E6 00          '..'
        STAB    M00DF                    ;FD2E: D7 DF          '..'
        LDAB    M00DA                    ;FD30: D6 DA          '..'
        CLRA                             ;FD32: 4F             'O'
        LSRB                             ;FD33: 54             'T'
        BCS     ZFD3D                    ;FD34: 25 07          '%.'
        LDAA    #$20                     ;FD36: 86 20          '. '
        LSRB                             ;FD38: 54             'T'
        BCS     ZFD3D                    ;FD39: 25 02          '%.'
        LDAA    #$10                     ;FD3B: 86 10          '..'
ZFD3D   STAA    M00E2                    ;FD3D: 97 E2          '..'
        LDX     #MFEBD                   ;FD3F: CE FE BD       '...'
        ABX                              ;FD42: 3A             ':'
        LDAA    ,X                       ;FD43: A6 00          '..'
        LDAB    M00E1                    ;FD45: D6 E1          '..'
        ORAB    #$80                     ;FD47: CA 80          '..'
        STD     M00E0                    ;FD49: DD E0          '..'
        PULB                             ;FD4B: 33             '3'
ZFD4C   PSHB                             ;FD4C: 37             '7'
        LDX     #M0000                   ;FD4D: CE 00 00       '...'
ZFD50   LDAA    $DD,X                    ;FD50: A6 DD          '..'
        ASLB                             ;FD52: 58             'X'
        BCC     ZFD56                    ;FD53: 24 01          '$.'
        CLRA                             ;FD55: 4F             'O'
ZFD56   STAA    $85,X                    ;FD56: A7 85          '..'
        INX                              ;FD58: 08             '.'
        CPX     #M0004                   ;FD59: 8C 00 04       '...'
        BCS     ZFD50                    ;FD5C: 25 F2          '%.'
        LDAA    M00E1                    ;FD5E: 96 E1          '..'
        ASLB                             ;FD60: 58             'X'
        BCC     ZFD65                    ;FD61: 24 02          '$.'
        ORAA    #$40                     ;FD63: 8A 40          '.@'
ZFD65   LDAB    M0092                    ;FD65: D6 92          '..'
ZFD67   SUBB    #$14                     ;FD67: C0 14          '..'
        BCC     ZFD67                    ;FD69: 24 FC          '$.'
        ADDB    #$0A                     ;FD6B: CB 0A          '..'
        BMI     ZFD71                    ;FD6D: 2B 02          '+.'
        ANDA    #$7F                     ;FD6F: 84 7F          '..'
ZFD71   PULB                             ;FD71: 33             '3'
        ANDB    #$03                     ;FD72: C4 03          '..'
        LDX     #MFDB1                   ;FD74: CE FD B1       '...'
        ABX                              ;FD77: 3A             ':'
        LDAB    M00E2                    ;FD78: D6 E2          '..'
        ORAB    ,X                       ;FD7A: EA 00          '..'
        STD     M0089                    ;FD7C: DD 89          '..'
ZFD7E   LDX     #MFFFF                   ;FD7E: CE FF FF       '...'
ZFD81   INX                              ;FD81: 08             '.'
        LDAA    M008B                    ;FD82: 96 8B          '..'
        BNE     ZFD81                    ;FD84: 26 FB          '&.'
        LDAA    #$03                     ;FD86: 86 03          '..'
        STAA    M008B                    ;FD88: 97 8B          '..'
        STX     M00E1                    ;FD8A: DF E1          '..'
        LDAA    M0002                    ;FD8C: 96 02          '..'
        TAB                              ;FD8E: 16             '.'
        COMA                             ;FD8F: 43             'C'
        ANDA    M00D7                    ;FD90: 94 D7          '..'
        STAB    M00D7                    ;FD92: D7 D7          '..'
        COMB                             ;FD94: 53             'S'
        ANDA    #$07                     ;FD95: 84 07          '..'
        ANDB    #$07                     ;FD97: C4 07          '..'
        PULX                             ;FD99: 38             '8'
        CMPB    #$03                     ;FD9A: C1 03          '..'
        BNE     ZFDA1                    ;FD9C: 26 03          '&.'
        JMP     ZFACD                    ;FD9E: 7E FA CD       '~..'
ZFDA1   CMPB    #$05                     ;FDA1: C1 05          '..'
        BNE     ZFDA8                    ;FDA3: 26 03          '&.'
        JMP     ZFAE2                    ;FDA5: 7E FA E2       '~..'
ZFDA8   CMPB    #$06                     ;FDA8: C1 06          '..'
        BNE     ZFDAF                    ;FDAA: 26 03          '&.'
        JMP     ZFBEE                    ;FDAC: 7E FB EE       '~..'
ZFDAF   JMP     ,X                       ;FDAF: 6E 00          'n.'
MFDB1   LSRD                             ;FDB1: 04             '.'
        FCB     $02                      ;FDB2: 02             '.'
        NOP                              ;FDB3: 01             '.'
        FCB     $00                      ;FDB4: 00             '.'
ZFDB5   PSHB                             ;FDB5: 37             '7'
        TAB                              ;FDB6: 16             '.'
        LDX     #MFE1F                   ;FDB7: CE FE 1F       '...'
        ABX                              ;FDBA: 3A             ':'
        ASLB                             ;FDBB: 58             'X'
        ABX                              ;FDBC: 3A             ':'
        LDAA    $02,X                    ;FDBD: A6 02          '..'
        STAA    M00E1                    ;FDBF: 97 E1          '..'
        LDX     ,X                       ;FDC1: EE 00          '..'
        PULB                             ;FDC3: 33             '3'
        ANDB    #$03                     ;FDC4: C4 03          '..'
        ABX                              ;FDC6: 3A             ':'
MFDC7   ASLB                             ;FDC7: 58             'X'
        ABX                              ;FDC8: 3A             ':'
        RTS                              ;FDC9: 39             '9'
ZFDCA   LDD     M0099                    ;FDCA: DC 99          '..'
        SUBD    M0096                    ;FDCC: 93 96          '..'
        ASLD                             ;FDCE: 05             '.'
        STD     M00D9                    ;FDCF: DD D9          '..'
        LSRD                             ;FDD1: 04             '.'
        ADDD    M0099                    ;FDD2: D3 99          '..'
        SUBD    ,X                       ;FDD4: A3 00          '..'
        LSRD                             ;FDD6: 04             '.'
        LDX     #M0010                   ;FDD7: CE 00 10       '...'
ZFDDA   SUBD    M00D9                    ;FDDA: 93 D9          '..'
        BCC     ZFDE0                    ;FDDC: 24 02          '$.'
        ADDD    M00D9                    ;FDDE: D3 D9          '..'
ZFDE0   ROL     >M00DC                   ;FDE0: 79 00 DC       'y..'
        ROL     >M00DB                   ;FDE3: 79 00 DB       'y..'
        ASLD                             ;FDE6: 05             '.'
        DEX                              ;FDE7: 09             '.'
        BNE     ZFDDA                    ;FDE8: 26 F0          '&.'
        LDAB    M00DC                    ;FDEA: D6 DC          '..'
        COMB                             ;FDEC: 53             'S'
        LDAA    M00DD                    ;FDED: 96 DD          '..'
        BPL     ZFE08                    ;FDEF: 2A 17          '*.'
        LDAA    #$E1                     ;FDF1: 86 E1          '..'
        MUL                              ;FDF3: 3D             '='
        ADDA    #$02                     ;FDF4: 8B 02          '..'
        STAA    M00D9                    ;FDF6: 97 D9          '..'
        LDAA    M00DB                    ;FDF8: 96 DB          '..'
        COMA                             ;FDFA: 43             'C'
        LDAB    #$E1                     ;FDFB: C6 E1          '..'
        MUL                              ;FDFD: 3D             '='
        ADDB    M00D9                    ;FDFE: DB D9          '..'
        ADCA    #$00                     ;FE00: 89 00          '..'
        LSRD                             ;FE02: 04             '.'
        LSRD                             ;FE03: 04             '.'
        SUBD    #M05C8                   ;FE04: 83 05 C8       '...'
        RTS                              ;FE07: 39             '9'
ZFE08   LDAA    #$7D                     ;FE08: 86 7D          '.}'
        MUL                              ;FE0A: 3D             '='
        ADDA    #$02                     ;FE0B: 8B 02          '..'
        STAA    M00D9                    ;FE0D: 97 D9          '..'
        LDAA    M00DB                    ;FE0F: 96 DB          '..'
        COMA                             ;FE11: 43             'C'
        LDAB    #$7D                     ;FE12: C6 7D          '.}'
        MUL                              ;FE14: 3D             '='
        ADDB    M00D9                    ;FE15: DB D9          '..'
        ADCA    #$00                     ;FE17: 89 00          '..'
        LSRD                             ;FE19: 04             '.'
        LSRD                             ;FE1A: 04             '.'
        SUBD    #M03E8                   ;FE1B: 83 03 E8       '...'
        RTS                              ;FE1E: 39             '9'
MFE1F   FCB     $00                      ;FE1F: 00             '.'
        BSR     ZFE42                    ;FE20: 8D 20          '. '
        FCB     $00                      ;FE22: 00             '.'
        EORA    $14,X                    ;FE23: A8 14          '..'
        FCB     $00                      ;FE25: 00             '.'
        STS     M0012                    ;FE26: 9F 12          '..'
        FCB     $00                      ;FE28: 00             '.'
        LDD     #M1100                   ;FE29: CC 11 00       '...'
        ORAA    M0C00                    ;FE2C: BA 0C 00       '...'
        CMPA    M0A00                    ;FE2F: B1 0A 00       '...'
        ADDD    #M0986                   ;FE32: C3 09 86       '...'
        FCB     $CD                      ;FE35: CD             '.'
        MUL                              ;FE36: 3D             '='
        LSRD                             ;FE37: 04             '.'
        LSRD                             ;FE38: 04             '.'
        LSRD                             ;FE39: 04             '.'
        PSHB                             ;FE3A: 37             '7'
        TAB                              ;FE3B: 16             '.'
        BEQ     ZFE44                    ;FE3C: 27 06          ''.'
ZFE3E   LDX     #MFEBD                   ;FE3E: CE FE BD       '...'
        ABX                              ;FE41: 3A             ':'
ZFE42   LDAA    ,X                       ;FE42: A6 00          '..'
ZFE44   PULB                             ;FE44: 33             '3'
        STAA    M00DF                    ;FE45: 97 DF          '..'
        LDAA    #$0A                     ;FE47: 86 0A          '..'
        MUL                              ;FE49: 3D             '='
        ADCA    #$00                     ;FE4A: 89 00          '..'
        TAB                              ;FE4C: 16             '.'
        LDX     #MFEBD                   ;FE4D: CE FE BD       '...'
        ABX                              ;FE50: 3A             ':'
        LDAB    ,X                       ;FE51: E6 00          '..'
        STAB    M00E0                    ;FE53: D7 E0          '..'
        LDAA    M00DF                    ;FE55: 96 DF          '..'
        RTS                              ;FE57: 39             '9'
ZFE58   STD     M00D9                    ;FE58: DD D9          '..'
        BPL     ZFE66                    ;FE5A: 2A 0A          '*.'
        LDAA    #$02                     ;FE5C: 86 02          '..'
        STAA    M00DD                    ;FE5E: 97 DD          '..'
        CLRA                             ;FE60: 4F             'O'
        CLRB                             ;FE61: 5F             '_'
        SUBD    M00D9                    ;FE62: 93 D9          '..'
        BRA     ZFE81                    ;FE64: 20 1B          ' .'
ZFE66   SUBD    #M03E8                   ;FE66: 83 03 E8       '...'
        BCC     ZFE6E                    ;FE69: 24 03          '$.'
        CLRA                             ;FE6B: 4F             'O'
        BRA     ZFE7D                    ;FE6C: 20 0F          ' .'
ZFE6E   STD     M00D9                    ;FE6E: DD D9          '..'
        SUBD    #M03E8                   ;FE70: 83 03 E8       '...'
        BCC     ZFE79                    ;FE73: 24 04          '$.'
        LDAA    #$28                     ;FE75: 86 28          '.('
        BRA     ZFE7D                    ;FE77: 20 04          ' .'
ZFE79   STD     M00D9                    ;FE79: DD D9          '..'
        LDAA    #$E6                     ;FE7B: 86 E6          '..'
ZFE7D   STAA    M00DD                    ;FE7D: 97 DD          '..'
        LDD     M00D9                    ;FE7F: DC D9          '..'
ZFE81   LDX     #MFEBC                   ;FE81: CE FE BC       '...'
ZFE84   INX                              ;FE84: 08             '.'
        SUBD    #M0064                   ;FE85: 83 00 64       '..d'
        BCC     ZFE84                    ;FE88: 24 FA          '$.'
        ADDB    #$64                     ;FE8A: CB 64          '.d'
        LDAA    ,X                       ;FE8C: A6 00          '..'
        CMPA    #$FC                     ;FE8E: 81 FC          '..'
        BNE     ZFE9C                    ;FE90: 26 0A          '&.'
        LDAA    M00DD                    ;FE92: 96 DD          '..'
        BEQ     ZFE9C                    ;FE94: 27 06          ''.'
        SUBA    #$02                     ;FE96: 80 02          '..'
        BEQ     ZFE9C                    ;FE98: 27 02          ''.'
        LDAA    #$FC                     ;FE9A: 86 FC          '..'
ZFE9C   STAA    M00DE                    ;FE9C: 97 DE          '..'
        LDAA    #$CD                     ;FE9E: 86 CD          '..'
        MUL                              ;FEA0: 3D             '='
        LSRD                             ;FEA1: 04             '.'
        LSRD                             ;FEA2: 04             '.'
        LSRD                             ;FEA3: 04             '.'
        PSHB                             ;FEA4: 37             '7'
        TAB                              ;FEA5: 16             '.'
        BRA     ZFE3E                    ;FEA6: 20 96          ' .'
ZFEA8   TBA                              ;FEA8: 17             '.'
        LSRB                             ;FEA9: 54             'T'
        LSRB                             ;FEAA: 54             'T'
        LSRB                             ;FEAB: 54             'T'
        LSRB                             ;FEAC: 54             'T'
        LDX     #MFEBD                   ;FEAD: CE FE BD       '...'
        ABX                              ;FEB0: 3A             ':'
        TAB                              ;FEB1: 16             '.'
        LDAA    ,X                       ;FEB2: A6 00          '..'
        ANDB    #$0F                     ;FEB4: C4 0F          '..'
        LDX     #MFEBD                   ;FEB6: CE FE BD       '...'
        ABX                              ;FEB9: 3A             ':'
        LDAB    ,X                       ;FEBA: E6 00          '..'
MFEBC   RTS                              ;FEBC: 39             '9'
MFEBD   LDD     M28E6                    ;FEBD: FC 28 E6       '.(.'
        LDS     $3A,X                    ;FEC0: AE 3A          '.:'
        LDS     M00DE                    ;FEC2: 9E DE          '..'
ZFEC4   BGE     ZFEC4                    ;FEC4: 2C FE          ',.'
        LDS     M7EDA                    ;FEC6: BE 7E DA       '.~.'
        ANDB    M00EA                    ;FEC9: D4 EA          '..'
        LDAB    M0056                    ;FECB: D6 56          '.V'
hdlr_RST CLRA                             ;FECD: 4F             'O'
        STAA    M0000                    ;FECE: 97 00          '..'
        COMA                             ;FED0: 43             'C'
        STAA    M0004                    ;FED1: 97 04          '..'
        STAA    M0005                    ;FED3: 97 05          '..'
        STAA    M0010                    ;FED5: 97 10          '..'
        LDAA    #$12                     ;FED7: 86 12          '..'
        STAA    M0001                    ;FED9: 97 01          '..'
        LDAA    #$08                     ;FEDB: 86 08          '..'
        STAA    M0008                    ;FEDD: 97 08          '..'
        LDX     #M0080                   ;FEDF: CE 00 80       '...'
ZFEE2   CLR     $7F,X                    ;FEE2: 6F 7F          'o.'
        DEX                              ;FEE4: 09             '.'
        BNE     ZFEE2                    ;FEE5: 26 FB          '&.'
        LDAA    #$01                     ;FEE7: 86 01          '..'
        STAA    M00C8                    ;FEE9: 97 C8          '..'
        STAA    M008C                    ;FEEB: 97 8C          '..'
        INCA                             ;FEED: 4C             'L'
        STAA    M00C5                    ;FEEE: 97 C5          '..'
        LDAA    #$0F                     ;FEF0: 86 0F          '..'
        STAA    M00CB                    ;FEF2: 97 CB          '..'
        LDD     #MFFFF                   ;FEF4: CC FF FF       '...'
        STD     M0085                    ;FEF7: DD 85          '..'
        STD     M0087                    ;FEF9: DD 87          '..'
        STD     M0089                    ;FEFB: DD 89          '..'
        LDS     #M00FF                   ;FEFD: 8E 00 FF       '...'
        CLI                              ;FF00: 0E             '.'
        LDD     #M0328                   ;FF01: CC 03 28       '..('
ZFF04   TST     >M008B                   ;FF04: 7D 00 8B       '}..'
        BNE     ZFF04                    ;FF07: 26 FB          '&.'
        STAA    M008B                    ;FF09: 97 8B          '..'
        DECB                             ;FF0B: 5A             'Z'
        BNE     ZFF04                    ;FF0C: 26 F6          '&.'
        LDX     #M000F                   ;FF0E: CE 00 0F       '...'
ZFF11   CLR     $8C,X                    ;FF11: 6F 8C          'o.'
        DEX                              ;FF13: 09             '.'
        BNE     ZFF11                    ;FF14: 26 FB          '&.'
        LDAB    #$05                     ;FF16: C6 05          '..'
ZFF18   TST     >M008B                   ;FF18: 7D 00 8B       '}..'
        BNE     ZFF18                    ;FF1B: 26 FB          '&.'
        STAA    M008B                    ;FF1D: 97 8B          '..'
        DECB                             ;FF1F: 5A             'Z'
        BNE     ZFF18                    ;FF20: 26 F6          '&.'
        LDX     #M000F                   ;FF22: CE 00 0F       '...'
ZFF25   LDD     $8A,X                    ;FF25: EC 8A          '..'
        ASLD                             ;FF27: 05             '.'
        ASLD                             ;FF28: 05             '.'
        STD     $8A,X                    ;FF29: ED 8A          '..'
        DEX                              ;FF2B: 09             '.'
        DEX                              ;FF2C: 09             '.'
        DEX                              ;FF2D: 09             '.'
        BNE     ZFF25                    ;FF2E: 26 F5          '&.'
        JSR     ZFA1D                    ;FF30: BD FA 1D       '...'
        LDX     #M0012                   ;FF33: CE 00 12       '...'
ZFF36   LDAA    $9E,X                    ;FF36: A6 9E          '..'
        STAA    $B0,X                    ;FF38: A7 B0          '..'
        DEX                              ;FF3A: 09             '.'
        BNE     ZFF36                    ;FF3B: 26 F9          '&.'
        LDD     M009F                    ;FF3D: DC 9F          '..'
        STD     M00C3                    ;FF3F: DD C3          '..'
        LDD     M00A2                    ;FF41: DC A2          '..'
        STD     M00C6                    ;FF43: DD C6          '..'
        LDD     M00A5                    ;FF45: DC A5          '..'
        STD     M00C9                    ;FF47: DD C9          '..'
        JMP     ZFA4E                    ;FF49: 7E FA 4E       '~.N'
hdlr_NMI FCB     $5E                      ;FF4C: 5E             '^'
ZFF4D   BRA     ZFF4D                    ;FF4D: 20 FE          ' .'
        STX     MFFFF                    ;FF4F: FF FF FF       '...'
        STX     MFFFF                    ;FF52: FF FF FF       '...'
        STX     MFFFF                    ;FF55: FF FF FF       '...'
        STX     MFFFF                    ;FF58: FF FF FF       '...'
        STX     MFFFF                    ;FF5B: FF FF FF       '...'
        STX     MFFFF                    ;FF5E: FF FF FF       '...'
        STX     MFFFF                    ;FF61: FF FF FF       '...'
        STX     MFFFF                    ;FF64: FF FF FF       '...'
        STX     MFFFF                    ;FF67: FF FF FF       '...'
        STX     MFFFF                    ;FF6A: FF FF FF       '...'
        STX     MFFFF                    ;FF6D: FF FF FF       '...'
        STX     MFFFF                    ;FF70: FF FF FF       '...'
        STX     MFFFF                    ;FF73: FF FF FF       '...'
        STX     MFFFF                    ;FF76: FF FF FF       '...'
        STX     MFFFF                    ;FF79: FF FF FF       '...'
        STX     MFFFF                    ;FF7C: FF FF FF       '...'
        STX     MFFFF                    ;FF7F: FF FF FF       '...'
        STX     MFFFF                    ;FF82: FF FF FF       '...'
        STX     MFFFF                    ;FF85: FF FF FF       '...'
        STX     MFFFF                    ;FF88: FF FF FF       '...'
        STX     MFFFF                    ;FF8B: FF FF FF       '...'
        STX     MFFFF                    ;FF8E: FF FF FF       '...'
        STX     MFFFF                    ;FF91: FF FF FF       '...'
        STX     MFFFF                    ;FF94: FF FF FF       '...'
        STX     MFFFF                    ;FF97: FF FF FF       '...'
        STX     MFFFF                    ;FF9A: FF FF FF       '...'
        STX     MFFFF                    ;FF9D: FF FF FF       '...'
        STX     MFFFF                    ;FFA0: FF FF FF       '...'
        STX     MFFFF                    ;FFA3: FF FF FF       '...'
        STX     MFFFF                    ;FFA6: FF FF FF       '...'
        STX     MFFFF                    ;FFA9: FF FF FF       '...'
        STX     MFFFF                    ;FFAC: FF FF FF       '...'
        STX     MFFFF                    ;FFAF: FF FF FF       '...'
        STX     MFFFF                    ;FFB2: FF FF FF       '...'
        STX     MFFFF                    ;FFB5: FF FF FF       '...'
        STX     MFFFF                    ;FFB8: FF FF FF       '...'
        STX     MFFFF                    ;FFBB: FF FF FF       '...'
        STX     MFFFF                    ;FFBE: FF FF FF       '...'
        STX     MFFFF                    ;FFC1: FF FF FF       '...'
        STX     MFFFF                    ;FFC4: FF FF FF       '...'
        STX     MFFFF                    ;FFC7: FF FF FF       '...'
        STX     MFFFF                    ;FFCA: FF FF FF       '...'
        STX     MFFFF                    ;FFCD: FF FF FF       '...'
        STX     MFFFF                    ;FFD0: FF FF FF       '...'
        STX     MFFFF                    ;FFD3: FF FF FF       '...'
        STX     MFFFF                    ;FFD6: FF FF FF       '...'
        STX     MFFFF                    ;FFD9: FF FF FF       '...'
        STX     MFFFF                    ;FFDC: FF FF FF       '...'
        STX     MFFFF                    ;FFDF: FF FF FF       '...'
        STX     MFFFF                    ;FFE2: FF FF FF       '...'
        STX     MFFFF                    ;FFE5: FF FF FF       '...'
        STX     MFFFF                    ;FFE8: FF FF FF       '...'
        STX     MFFFF                    ;FFEB: FF FF FF       '...'
        STX     MFFF9                    ;FFEE: FF FF F9       '...'
        FDB     $CEF9                    ;FFF1: CE F9          '..'
        FDB     $CEF8                    ;FFF3: CE F8          '..'
        FDB     $00F9                    ;FFF5: 00 F9          '..'
        FDB     $CEF9                    ;FFF7: CE F9          '..'
MFFF9   FDB     $CEF9                    ;FFF9: CE F9          '..'
        FDB     $CEFF                    ;FFFB: CE FF          '..'
        FDB     $4CFE                    ;FFFD: 4C FE          'L.'
MFFFF   FDB     $CD01                    ;FFFF: CD 01          '..'

        END
